## arch/arm64/Kconfig.projects
```kconfig
config SEC_GTA4XLVE_PROJECT
	default n
	bool "Samsung GTA4XLVE Project"
	help
	  Support for Samsung GTA4XLVE Project

config SEC_GTA4XLVE_EUR_OPEN
	default n
	bool "Samsung GTA4XLVE EUR OPEN"
	help
	  Support for Samsung GTA4XLVE EUR OPEN device.
```

## drivers/adsp_factory/Kconfig
```kconfig
#
# factory sensor drivers configuration
#
config ADSP_FACTORY
	tristate "MSM ADSP factory driver"
	default n
	help
	  This driver communicate with SSC DAEMON.
	  register each sensor device.
	  send selftest request using netlink.
	  receive test result using netlink.

config LSM6DSO_FACTORY
	tristate "factory test for SSC - LSM6DSO"
	default n
	help
	  lsm6dso factory driver.
	  provide sysfs for factory test.
	  request selftest to adsp_factory.
	  receive test result from adsp_factory.

config VEML3328_FACTORY
	tristate "factory test for SSC - veml3328"
	default n
	help
	  veml3328 factory driver.
	  provide sysfs for factory test.
	  request selftest to adsp_factory.
	  receive test result from adsp_factory.

config SUPPORT_BHL_COMPENSATION_FOR_LIGHT_SENSOR
	tristate "Sensors support BHL compensation"
	default n
	help
	  Support BHL compensation for light sensor
	  provide sysfs for LCD service.
	  receive aor and brightness level from lcd driver.

config SUPPORT_LIGHT_READ_UBID
	tristate "support lcd ub id for light sensor"
	default n
	depends on ADSP_FACTORY
	help
	  receive lcd type from lcd sysfs.
	  send lcd rev to light driver.

config SUPPORT_SSC_MODE
	tristate "Support ssc mode function for adsp sensor"
	default n
	depends on ADSP_FACTORY
	help
	  Support the ssc mode function.

config MMC5603X_FACTORY
	tristate "factory test for SSC - MMC5603X"
	default n
	help
	  mmc5603x factory driver.
	  provide sysfs for factory test.
	  request selftest to adsp_factory.
	  receive test result from adsp_factory.

config SUPPORT_SSC_MODE_FOR_MAG
	tristate "Support ssc mode for mag function for mag sensor"
	default n
	depends on ADSP_FACTORY
	help
	  Support the ssc mode for mag function.

config SUPPORT_PROX_DUALIZATION
	tristate "Support dualization for prox sensor"
	default n
	depends on ADSP_FACTORY
	help
	  Support the dualization for prox function.

config NOT_SUPPORT_PROX_FACTORY
	tristate "Not Support prox sensor as it is supporting PROTOS"
	default n
	depends on ADSP_FACTORY
	help
	  Not Support prox function.

config SLPI_MOTOR
	tristate "Sensors support motor"
	default n
	help
	  Support the motor state function
	  provide sysfs for factory test.
	  request selftest to adsp_factory.
	  receive test result from adsp_factory.

config FLIP_COVER_DETECTOR_FACTORY
	tristate "factory test for SSC - Flip Cover Detector"
	default n
	help
	  flip_cover_detector factory driver.
	  provide sysfs for cover status by nfc.
```

## drivers/gpu/drm/msm/samsung_lego/Kconfig
```kconfig
config SAMSUNG_DEBUG_DISPLAY
	bool "Add Samsung Debugging code"
	default n

config DISPLAY_SAMSUNG_LEGO
	bool "mdss config for samsung product"
	default n
	---help---
	Mdss config signature for samsung product

#
#	PANEL UNIQUE FEATURE
#
config DUAL_PANEL
	depends on DISPLAY_SAMSUNG
	bool "dual paneloperation"
	default n
	---help---
	dual panel operation support

config PARTIAL_UPDATE
	depends on DISPLAY_SAMSUNG
	bool "partial update operation"
	default n
	---help---
	partial update operation support

config CABC_FUNCTION
	depends on DISPLAY_SAMSUNG
	bool "DDI cabc operation"
	default n
	---help---
	DDI cabc operation support

config SUPPORT_POC_FLASH
	depends on DISPLAY_SAMSUNG
	bool "SUPPORT POC FLASH"
	default n
	---help---
	SUPPORT_POC_FLASH FOR DREAM2 ONLY

#
#	HOW TO MAKE DEF-CONFIG NAME FOR PANEL
#
#	PANEL_DDI-model_PANEL-model_RESOLUTION
#	PANEL_S6E3FA2    _AMS510CV01_FHD
#	PANEL_S6E3FA2_AMS510CV01_FHD
#
config PANEL_HX83102_TV104WUM_WUXGA
	depends on DISPLAY_SAMSUNG || DISPLAY_SAMSUNG_LEGO
	bool "HIMAX HX83102 LDI"
	default n
	---help---
	HIMAX HX83102 LDI 1200_2000 GTS6LITE
```

## drivers/input/sec_input/Kconfig
```kconfig
#
# Sec_Input device configuration
#

config SEC_DEBUG_TSP_LOG_LEGO
	bool "SEC_DEBUG_TSP_LOG_LEGO"
	help
		Say Y here if you have a SEC_DEBUG_TSP_LOG_LEGO.
		If unsure, say N.
		
config INPUT_SEC_INPUT_LEGO
	bool "INPUT_SEC_INPUT_LEGO"
	help
		Say Y here if you have a INPUT_SEC_INPUT_LEGO.
		If unsure, say N.
```

## drivers/samsung/Kconfig
```kconfig
config DRV_SAMSUNG
	tristate "Samsung sec class/sysfs Feature"
	default n
	help
	  Samsung sysfs name 'sec' directory create
```

## drivers/sensors/Kconfig
```kconfig
config SENSORS
	bool "Sensors Class Support"
	help
	  This option enables the sensor sysfs class in /sys/class/sensors.
	  You'll need this to do anything useful with sensorss. If unsure, say N.

config SENSORS_SSC
	bool "Enable Sensors Driver Support for SSC"
	help
	  Add support for sensors SSC driver.
	  This driver is used for exercising sensors use case,
	  time syncing with ADSP clock.

config SENSORS_ISG6320
	depends on I2C
	tristate "ISG6320 grip"
	default n
	help
	  If you say yes here if you use ISG6320 for grip.
	  This option enables grip sensors using
	  IMAGIS ISG6320 device driver for grip.

config SENSORS_ISG6320_WIFI
	depends on I2C
	tristate "ISG6320 grip wifi"
	default n
	help
	  If you say yes here if you use ISG6320_WIFI for grip.
	  This option enables grip sensors using
	  IMAGIS ISG6320_WIFI device driver for grip.

config USE_MULTI_CHANNEL
	tristate "Grip sensor multi chennel"
	default n
	help
	  Enable grip multi channel
	  This option enables feature that is related multi-Channel for grip Sensor.

config USE_SINGLE_IRQ_B
	tristate "Grip sensor single irq b"
	default n
	help
	  Enable grip single irq b
	  This option enables feature that is related single irq b for grip Sensor.
```

## drivers/usb/typec/Kconfig
```kconfig
menu "USB Power Delivery and Type-C drivers"

config TYPEC
	bool "Using USB Type-C device driver"
	depends on ANDROID_MAJOR_VERSION != "o"
	default n
	help
	  If you say yes here you will get support for
	  the USB Type-C device driver.

config TYPEC_WCOVE
	tristate "Intel WhiskeyCove PMIC USB Type-C PHY driver"
	depends on ACPI
	depends on INTEL_SOC_PMIC
	depends on INTEL_PMC_IPC
	depends on BXT_WC_PMIC_OPREGION
	select TYPEC
	help
	  This driver adds support for USB Type-C detection on Intel Broxton
	  platforms that have Intel Whiskey Cove PMIC. The driver can detect the
	  role and cable orientation.

	  To compile this driver as module, choose M here: the module will be
	  called typec_wcove

config USE_PDIC_LEGO
	bool "Using PDIC LEGO"
	default n
	help
	  If you say yes here you will get support for
	  the PDIC device driver written in LEGO style.

source "drivers/usb/typec/ucsi/Kconfig"

source "drivers/usb/typec/manager_lego/Kconfig"

source "drivers/usb/typec/common/Kconfig"

source "drivers/usb/typec/sm/sm5714/Kconfig"

endmenu
```
